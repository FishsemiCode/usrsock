## Kconfig
```kconfig
#
# For a description of the syntax of this configuration file,
# see the file kconfig-language.txt in the NuttX tools repository.
#

config RPMSG_USRSOCK
	bool "RPMSG usrsock"
	default n
	depends on NET && OPENAMP
	---help---
		Enable usrsock through rpmsg channel.

if RPMSG_USRSOCK

config RPMSG_USRSOCK_PRIORITY
	int "usrsock task priority"
	default 230
	---help---
		The priority for usrsock task.

config RPMSG_USRSOCK_STACKSIZE
	int "usrsock task stack size"
	default 2048
	---help---
	The stack size allocated for the usrsock task.

endif # RPMSG_USRSOCK
```
